## keyboard/tsuki65/firmware/boards/shields/tsuki65/Kconfig.defconfig
```kconfig
if SHIELD_TSUKI65_LEFT || SHIELD_TSUKI65_RIGHT

config ZMK_KEYBOARD_NAME
    default "tsuki65"

config ZMK_SPLIT
    default y

config SPI
    default y

config INPUT
    default y

config ZMK_MOUSE
    default y

endif
```

## keyboard/tsuki65/firmware/boards/shields/tsuki65/Kconfig.shield
```kconfig
config SHIELD_TSUKI65_LEFT
    def_bool $(shields_list_contains,tsuki65_left)

config SHIELD_TSUKI65_RIGHT
    def_bool $(shields_list_contains,tsuki65_right)
```
